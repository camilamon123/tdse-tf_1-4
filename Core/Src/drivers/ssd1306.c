/*
 * ssd1306.c
 *
 *  Created on: Feb 10, 2026
 *      Author: feder
 */

#include "drivers/ssd1306.h"
#include <string.h>

/* ===================== GPIO helpers ===================== */

static inline void cs_low(ssd1306_t *d)  { HAL_GPIO_WritePin(d->cs_port,  d->cs_pin,  GPIO_PIN_RESET); }
static inline void cs_high(ssd1306_t *d) { HAL_GPIO_WritePin(d->cs_port,  d->cs_pin,  GPIO_PIN_SET); }

static inline void dc_cmd(ssd1306_t *d)  { HAL_GPIO_WritePin(d->dc_port,  d->dc_pin,  GPIO_PIN_RESET); }
static inline void dc_data(ssd1306_t *d) { HAL_GPIO_WritePin(d->dc_port,  d->dc_pin,  GPIO_PIN_SET); }

static inline void res_low(ssd1306_t *d) { HAL_GPIO_WritePin(d->res_port, d->res_pin, GPIO_PIN_RESET); }
static inline void res_high(ssd1306_t *d){ HAL_GPIO_WritePin(d->res_port, d->res_pin, GPIO_PIN_SET); }

/* ===================== Font 5x7 ===================== */
static const uint8_t font5x7[][5] = {
  /* 0x20 ' ' */ {0x00,0x00,0x00,0x00,0x00},
  /* 0x21 '!' */ {0x00,0x00,0x5F,0x00,0x00},
  /* 0x22 '"' */ {0x00,0x07,0x00,0x07,0x00},
  /* 0x23 '#' */ {0x14,0x7F,0x14,0x7F,0x14},
  /* 0x24 '$' */ {0x24,0x2A,0x7F,0x2A,0x12},
  /* 0x25 '%' */ {0x23,0x13,0x08,0x64,0x62},
  /* 0x26 '&' */ {0x36,0x49,0x55,0x22,0x50},
  /* 0x27 ''' */ {0x00,0x05,0x03,0x00,0x00},
  /* 0x28 '(' */ {0x00,0x1C,0x22,0x41,0x00},
  /* 0x29 ')' */ {0x00,0x41,0x22,0x1C,0x00},
  /* 0x2A '*' */ {0x14,0x08,0x3E,0x08,0x14},
  /* 0x2B '+' */ {0x08,0x08,0x3E,0x08,0x08},
  /* 0x2C ',' */ {0x00,0x50,0x30,0x00,0x00},
  /* 0x2D '-' */ {0x08,0x08,0x08,0x08,0x08},
  /* 0x2E '.' */ {0x00,0x60,0x60,0x00,0x00},
  /* 0x2F '/' */ {0x20,0x10,0x08,0x04,0x02},

  /* 0x30 '0' */ {0x3E,0x51,0x49,0x45,0x3E},
  /* 0x31 '1' */ {0x00,0x42,0x7F,0x40,0x00},
  /* 0x32 '2' */ {0x42,0x61,0x51,0x49,0x46},
  /* 0x33 '3' */ {0x21,0x41,0x45,0x4B,0x31},
  /* 0x34 '4' */ {0x18,0x14,0x12,0x7F,0x10},
  /* 0x35 '5' */ {0x27,0x45,0x45,0x45,0x39},
  /* 0x36 '6' */ {0x3C,0x4A,0x49,0x49,0x30},
  /* 0x37 '7' */ {0x01,0x71,0x09,0x05,0x03},
  /* 0x38 '8' */ {0x36,0x49,0x49,0x49,0x36},
  /* 0x39 '9' */ {0x06,0x49,0x49,0x29,0x1E},
  /* 0x3A ':' */ {0x00,0x36,0x36,0x00,0x00},
  /* 0x3B ';' */ {0x00,0x56,0x36,0x00,0x00},
  /* 0x3C '<' */ {0x08,0x14,0x22,0x41,0x00},
  /* 0x3D '=' */ {0x14,0x14,0x14,0x14,0x14},
  /* 0x3E '>' */ {0x00,0x41,0x22,0x14,0x08},
  /* 0x3F '?' */ {0x02,0x01,0x51,0x09,0x06},

  /* 0x40 '@' */ {0x32,0x49,0x79,0x41,0x3E},
  /* 0x41 'A' */ {0x7E,0x11,0x11,0x11,0x7E},
  /* 0x42 'B' */ {0x7F,0x49,0x49,0x49,0x36},
  /* 0x43 'C' */ {0x3E,0x41,0x41,0x41,0x22},
  /* 0x44 'D' */ {0x7F,0x41,0x41,0x22,0x1C},
  /* 0x45 'E' */ {0x7F,0x49,0x49,0x49,0x41},
  /* 0x46 'F' */ {0x7F,0x09,0x09,0x09,0x01},
  /* 0x47 'G' */ {0x3E,0x41,0x49,0x49,0x7A},
  /* 0x48 'H' */ {0x7F,0x08,0x08,0x08,0x7F},
  /* 0x49 'I' */ {0x00,0x41,0x7F,0x41,0x00},
  /* 0x4A 'J' */ {0x20,0x40,0x41,0x3F,0x01},
  /* 0x4B 'K' */ {0x7F,0x08,0x14,0x22,0x41},
  /* 0x4C 'L' */ {0x7F,0x40,0x40,0x40,0x40},
  /* 0x4D 'M' */ {0x7F,0x02,0x0C,0x02,0x7F},
  /* 0x4E 'N' */ {0x7F,0x04,0x08,0x10,0x7F},
  /* 0x4F 'O' */ {0x3E,0x41,0x41,0x41,0x3E},

  /* 0x50 'P' */ {0x7F,0x09,0x09,0x09,0x06},
  /* 0x51 'Q' */ {0x3E,0x41,0x51,0x21,0x5E},
  /* 0x52 'R' */ {0x7F,0x09,0x19,0x29,0x46},
  /* 0x53 'S' */ {0x46,0x49,0x49,0x49,0x31},
  /* 0x54 'T' */ {0x01,0x01,0x7F,0x01,0x01},
  /* 0x55 'U' */ {0x3F,0x40,0x40,0x40,0x3F},
  /* 0x56 'V' */ {0x1F,0x20,0x40,0x20,0x1F},
  /* 0x57 'W' */ {0x3F,0x40,0x38,0x40,0x3F},
  /* 0x58 'X' */ {0x63,0x14,0x08,0x14,0x63},
  /* 0x59 'Y' */ {0x07,0x08,0x70,0x08,0x07},
  /* 0x5A 'Z' */ {0x61,0x51,0x49,0x45,0x43},
  /* 0x5B '[' */ {0x00,0x7F,0x41,0x41,0x00},
  /* 0x5C '\' */ {0x02,0x04,0x08,0x10,0x20},
  /* 0x5D ']' */ {0x00,0x41,0x41,0x7F,0x00},
  /* 0x5E '^' */ {0x04,0x02,0x01,0x02,0x04},
  /* 0x5F '_' */ {0x40,0x40,0x40,0x40,0x40},

  /* 0x60 '`' */ {0x00,0x01,0x02,0x04,0x00},
  /* 0x61 'a' */ {0x20,0x54,0x54,0x54,0x78},
  /* 0x62 'b' */ {0x7F,0x48,0x44,0x44,0x38},
  /* 0x63 'c' */ {0x38,0x44,0x44,0x44,0x20},
  /* 0x64 'd' */ {0x38,0x44,0x44,0x48,0x7F},
  /* 0x65 'e' */ {0x38,0x54,0x54,0x54,0x18},
  /* 0x66 'f' */ {0x08,0x7E,0x09,0x01,0x02},
  /* 0x67 'g' */ {0x0C,0x52,0x52,0x52,0x3E},
  /* 0x68 'h' */ {0x7F,0x08,0x04,0x04,0x78},
  /* 0x69 'i' */ {0x00,0x44,0x7D,0x40,0x00},
  /* 0x6A 'j' */ {0x20,0x40,0x44,0x3D,0x00},
  /* 0x6B 'k' */ {0x7F,0x10,0x28,0x44,0x00},
  /* 0x6C 'l' */ {0x00,0x41,0x7F,0x40,0x00},
  /* 0x6D 'm' */ {0x7C,0x04,0x18,0x04,0x78},
  /* 0x6E 'n' */ {0x7C,0x08,0x04,0x04,0x78},
  /* 0x6F 'o' */ {0x38,0x44,0x44,0x44,0x38},

  /* 0x70 'p' */ {0x7C,0x14,0x14,0x14,0x08},
  /* 0x71 'q' */ {0x08,0x14,0x14,0x18,0x7C},
  /* 0x72 'r' */ {0x7C,0x08,0x04,0x04,0x08},
  /* 0x73 's' */ {0x48,0x54,0x54,0x54,0x20},
  /* 0x74 't' */ {0x04,0x3F,0x44,0x40,0x20},
  /* 0x75 'u' */ {0x3C,0x40,0x40,0x20,0x7C},
  /* 0x76 'v' */ {0x1C,0x20,0x40,0x20,0x1C},
  /* 0x77 'w' */ {0x3C,0x40,0x30,0x40,0x3C},
  /* 0x78 'x' */ {0x44,0x28,0x10,0x28,0x44},
  /* 0x79 'y' */ {0x0C,0x50,0x50,0x50,0x3C},
  /* 0x7A 'z' */ {0x44,0x64,0x54,0x4C,0x44},
  /* 0x7B '{' */ {0x00,0x08,0x36,0x41,0x00},
  /* 0x7C '|' */ {0x00,0x00,0x7F,0x00,0x00},
  /* 0x7D '}' */ {0x00,0x41,0x36,0x08,0x00},
  /* 0x7E '~' */ {0x08,0x04,0x08,0x10,0x08}
};

/* ===================== SPI low-level ===================== */

static HAL_StatusTypeDef spi_tx(ssd1306_t *d, const uint8_t *data, size_t len)
{
  return HAL_SPI_Transmit(d->hspi, (uint8_t*)data, (uint16_t)len, 200);
}

static HAL_StatusTypeDef write_cmd1(ssd1306_t *d, uint8_t c)
{
  cs_low(d);
  dc_cmd(d);
  HAL_StatusTypeDef st = spi_tx(d, &c, 1);
  cs_high(d);
  return st;
}

static HAL_StatusTypeDef write_cmd2(ssd1306_t *d, uint8_t c, uint8_t p)
{
  uint8_t b[2] = { c, p };
  cs_low(d);
  dc_cmd(d);
  HAL_StatusTypeDef st = spi_tx(d, b, 2);
  cs_high(d);
  return st;
}

static HAL_StatusTypeDef write_cmd3(ssd1306_t *d, uint8_t c, uint8_t p1, uint8_t p2)
{
  uint8_t b[3] = { c, p1, p2 };
  cs_low(d);
  dc_cmd(d);
  HAL_StatusTypeDef st = spi_tx(d, b, 3);
  cs_high(d);
  return st;
}

static HAL_StatusTypeDef write_data(ssd1306_t *d, const uint8_t *data, size_t len)
{
  cs_low(d);
  dc_data(d);
  HAL_StatusTypeDef st = spi_tx(d, data, len);
  cs_high(d);
  return st;
}

static void hw_reset(ssd1306_t *d)
{
  /* Reset activo en bajo */
  res_low(d);
  HAL_Delay(10);
  res_high(d);
  HAL_Delay(10);
}

/* ===================== Public API ===================== */

HAL_StatusTypeDef SSD1306_Init(ssd1306_t *d,
                               SPI_HandleTypeDef *hspi,
                               GPIO_TypeDef *cs_port, uint16_t cs_pin,
                               GPIO_TypeDef *dc_port, uint16_t dc_pin,
                               GPIO_TypeDef *res_port, uint16_t res_pin,
                               uint8_t addr7 )
{
  (void)addr7;

  if (!d || !hspi || !cs_port || !dc_port || !res_port) return HAL_ERROR;

  memset(d, 0, sizeof(*d));

  d->hspi     = hspi;
  d->cs_port  = cs_port;  d->cs_pin  = cs_pin;
  d->dc_port  = dc_port;  d->dc_pin  = dc_pin;
  d->res_port = res_port; d->res_pin = res_pin;

  d->width  = (uint8_t)SSD1306_WIDTH;
  d->height = (uint8_t)SSD1306_HEIGHT;
  d->pages  = (uint8_t)SSD1306_PAGES;

  d->x_offset = 0u;
  d->cursor_x = 0u;
  d->cursor_y = 0u;

  /* Estado seguro */
  cs_high(d);
  dc_cmd(d);
  res_high(d);

  hw_reset(d);

  /* Init sequence SSD1306 (clásica) */
  if (write_cmd1(d, 0xAE) != HAL_OK) return HAL_ERROR;                 /* display off */
  if (write_cmd2(d, 0xD5, 0x80) != HAL_OK) return HAL_ERROR;           /* clock div */
  if (write_cmd2(d, 0xA8, (uint8_t)(d->height - 1u)) != HAL_OK) return HAL_ERROR; /* multiplex */
  if (write_cmd2(d, 0xD3, 0x00) != HAL_OK) return HAL_ERROR;           /* display offset */
  if (write_cmd1(d, 0x40) != HAL_OK) return HAL_ERROR;                 /* start line = 0 */

  /* charge pump on (para módulos comunes) */
  if (write_cmd2(d, 0x8D, 0x14) != HAL_OK) return HAL_ERROR;

  /* memory addressing mode: horizontal */
  if (write_cmd2(d, 0x20, 0x00) != HAL_OK) return HAL_ERROR;

  /* remap + scan dir */
  if (write_cmd1(d, 0xA1) != HAL_OK) return HAL_ERROR;                 /* seg remap */
  if (write_cmd1(d, 0xC8) != HAL_OK) return HAL_ERROR;                 /* com scan dec */

  /* COM pins config */
  if (d->height == 64u)
  {
    if (write_cmd2(d, 0xDA, 0x12) != HAL_OK) return HAL_ERROR;
  }
  else
  {
    if (write_cmd2(d, 0xDA, 0x02) != HAL_OK) return HAL_ERROR;
  }

  /* contrast */
  if (write_cmd2(d, 0x81, 0x7F) != HAL_OK) return HAL_ERROR;

  /* precharge + vcom */
  if (write_cmd2(d, 0xD9, 0xF1) != HAL_OK) return HAL_ERROR;
  if (write_cmd2(d, 0xDB, 0x40) != HAL_OK) return HAL_ERROR;

  if (write_cmd1(d, 0xA4) != HAL_OK) return HAL_ERROR;                 /* resume RAM */
  if (write_cmd1(d, 0xA6) != HAL_OK) return HAL_ERROR;                 /* normal display */
  if (write_cmd1(d, 0xAF) != HAL_OK) return HAL_ERROR;                 /* display on */

  SSD1306_Clear(d);
  return SSD1306_Update(d);
}

void SSD1306_Clear(ssd1306_t *d)
{
  if (!d) return;
  memset(d->buf, 0x00, sizeof(d->buf));
  d->cursor_x = 0u;
  d->cursor_y = 0u;
}

void SSD1306_Fill(ssd1306_t *d, uint8_t color)
{
  if (!d) return;
  memset(d->buf, color ? 0xFF : 0x00, sizeof(d->buf));
}

HAL_StatusTypeDef SSD1306_Update(ssd1306_t *d)
{
  if (!d) return HAL_ERROR;

  /* Set column address */
  uint8_t col_start = d->x_offset;
  uint8_t col_end   = (uint8_t)(d->x_offset + d->width - 1u);

  if (write_cmd3(d, 0x21, col_start, col_end) != HAL_OK) return HAL_ERROR;
  if (write_cmd3(d, 0x22, 0x00, (uint8_t)(d->pages - 1u)) != HAL_OK) return HAL_ERROR;

  /* Enviar framebuffer completo */
  return write_data(d, d->buf, (size_t)(d->width * d->pages));
}

/* ===================== Drawing ===================== */

void SSD1306_DrawPixel(ssd1306_t *d, uint8_t x, uint8_t y, uint8_t color)
{
  if (!d) return;
  if (x >= d->width || y >= d->height) return;

  uint16_t index = (uint16_t)x + (uint16_t)(y / 8u) * (uint16_t)d->width;
  uint8_t  mask  = (uint8_t)(1u << (y & 7u));

  if (color) d->buf[index] |= mask;
  else       d->buf[index] &= (uint8_t)~mask;
}

void SSD1306_SetCursor(ssd1306_t *d, uint8_t x, uint8_t y)
{
  if (!d) return;
  d->cursor_x = x;
  d->cursor_y = y;
}

void SSD1306_DrawChar5x7(ssd1306_t *d, char c)
{
  if (!d) return;

  if (c < 32 || c > 126) c = '?';
  const uint8_t *glyph = font5x7[(uint8_t)c - 32u];

  /* Cada char: 5 px ancho + 1 columna de espacio */
  uint8_t x0 = d->cursor_x;
  uint8_t y0 = d->cursor_y;

  /* Dibuja columnas (bits verticales) */
  for (uint8_t col = 0; col < 5u; col++)
  {
    uint8_t bits = glyph[col];
    for (uint8_t row = 0; row < 7u; row++)
    {
      uint8_t on = (bits >> row) & 0x01u;
      SSD1306_DrawPixel(d, (uint8_t)(x0 + col), (uint8_t)(y0 + row), on);
    }
  }

  /* espacio entre chars */
  for (uint8_t row = 0; row < 7u; row++)
  {
    SSD1306_DrawPixel(d, (uint8_t)(x0 + 5u), (uint8_t)(y0 + row), 0u);
  }

  d->cursor_x = (uint8_t)(d->cursor_x + 6u);
}

void SSD1306_DrawString5x7(ssd1306_t *d, const char *s)
{
  if (!d || !s) return;

  while (*s)
  {
    char c = *s++;

    if (c == '\n')
    {
      d->cursor_x = 0u;
      d->cursor_y = (uint8_t)(d->cursor_y + 8u);
      continue;
    }
    if (c == '\r')
      continue;

    /* Wrap simple por ancho */
    if ((uint8_t)(d->cursor_x + 6u) >= d->width)
    {
      d->cursor_x = 0u;
      d->cursor_y = (uint8_t)(d->cursor_y + 8u);
    }

    /* si se fue de alto se cortaaa */
    if ((uint8_t)(d->cursor_y + 7u) >= d->height)
      break;

    SSD1306_DrawChar5x7(d, c);
  }
}
